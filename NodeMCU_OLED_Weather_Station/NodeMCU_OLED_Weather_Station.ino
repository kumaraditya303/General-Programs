/*
  NodeMCU OLED Weather Station 

  Fetches Weather Information from a weather station by using API and displays it on OLED Display.

  Before uploading change these lines a per your need:
    const char *ssid = "**********";    // WIFI network name
    const char *password = "*********"; // WIFI network password
    const String key = "xxxxxxxxxxxxxxxxx"; // replace it with your api key 

  Parts list:

  NodeMCU :
  https://www.amazon.in/Generic-Nodemcu-Esp8266-Internet-Development/dp/B07262H53W/ref=sr_1_1?keywords=nodemcu&qid=1583588225&sr=8-1

  
  Project made and maintained by Kumar Aditya


  The source code along with libraries can be found at:
  https://github.com/rahuladitya303/programs/tree/master/NodeMCU_OLED_Weather_Station

  Image2cpp : https://javl.github.io/image2cpp/

*/
#include <Wire.h>
#include <Adafruit_GFX.h>
#include <Adafruit_SSD1306.h>
#include <ESP8266WiFi.h>
#include <ESP8266HTTPClient.h>
#include <WiFiClient.h>
#include <ArduinoJson.h>
const char *ssid = "**********";    // WI
FI network name
const char *password = "*********"; // WIFI network password

const String endpoint = "http://api.openweathermap.org/data/2.5/weather?q=Patna,in&APPID=";
const String key = "xxxxxxxxxxxxxxxxx"; // replace it with your api key 

#define SCREEN_WIDTH 128 // OLED display width, in pixels
#define SCREEN_HEIGHT 64 // OLED display height, in pixels
#define OLED_RESET -1 // -1 because NodeMCU reset would be shared internally

// Declaration for an SSD1306 display connected to I2C (SDA, SCL pins)
Adafruit_SSD1306 display(SCREEN_WIDTH, SCREEN_HEIGHT, &Wire, -1);
// Custome LOGO at the first screen 
static const unsigned char PROGMEM logo_bmp[] =
{ 
  0xff, 0xff, 0xff, 0xff, 0xe0, 0xff, 0xff, 0xff, 0xff, 0xff, 0xff, 0xff, 0x80, 0x3f, 0xff, 0xff,
  0xff, 0xff, 0xff, 0xff, 0x00, 0x1f, 0xff, 0xff, 0xff, 0xff, 0xff, 0xfc, 0x00, 0x0f, 0xff, 0xff,
  0xff, 0xff, 0xff, 0xf0, 0x00, 0x07, 0xff, 0xff, 0xff, 0xff, 0xff, 0xe0, 0x00, 0x07, 0xff, 0xff,
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  0xff, 0xff, 0xfc, 0x01, 0xff, 0xff, 0xff, 0xff, 0xff, 0xff, 0xff, 0x07, 0xff, 0xff, 0xff, 0xff
};


void setup() {
  Serial.begin(115200); // change baudrate as per your need 

  if (!display.begin(SSD1306_SWITCHCAPVCC, 0x3C)) { // if allocation fails try 0x3D
    Serial.println("SSD1306 allocation failed");
    for (;;);
  }
  pinMode(16, OUTPUT);
  pinMode(2, OUTPUT);
  digitalWrite(2, HIGH);
  digitalWrite(16, HIGH);


  WiFi.begin(ssid, password);
  Serial.print("\nConnecting to WiFi network");

  while (WiFi.status() != WL_CONNECTED)
  {

    Serial.print(".");
    digitalWrite(2, HIGH);
    delay(500);
    digitalWrite(2, LOW);
    delay(500);
  }
  startWiFi();
}
void startWiFi() {
  testdrawbitmap();
  display.clearDisplay();
  String text = "Connected to the WiFi network: " + WiFi.SSID() + " and strength is: " + WiFi.RSSI();
  display.setTextSize(2); // Draw 2X-scale text
  display.setTextColor(WHITE);
  display.setCursor(10, 0);
  display.println(text);
  display.display();      // Show initial text
  delay(100);
  Serial.println("\nConnected to the WiFi network: " + WiFi.SSID() + " and strength is: " + WiFi.RSSI());
  display.startscrollleft(0x00, 0x0F);
  delay(5000);
  display.stopscroll();

}
void loop() {
  const int frequency = 1000 * 30; // change 30 to change the number of seconds
  String payload;
  if ((WiFi.status() == WL_CONNECTED))
  { //Check the current connection status
    digitalWrite(2, LOW);
    HTTPClient http;

    http.begin(endpoint + key); //Specify the URL
    int httpCode = http.GET();  //Make the request

    if (httpCode > 0)
    { //Check for the returning code

      payload = http.getString();
      digitalWrite(16, LOW);
      delay(1000);
      digitalWrite(16, HIGH);
      // Serial.println(httpCode);
    }

    else
    {
      Serial.println("Error on HTTP request");
      display.clearDisplay();
      display.setTextSize(1);
      display.setTextColor(WHITE);
      display.setCursor(0, 10);
      display.println("Error");
      display.display();
    }
    Serial.flush();
    DynamicJsonDocument doc(1024); // creating a json object
    String json = payload;

    deserializeJson(doc, json);// deserializing json  
    // parsing json and getiing data
    JsonObject main = doc["main"];
    float temp = main["temp"]; 
    temp -= 273.15;
    int pressure = main["pressure"];         
    int humidity = main["humidity"];         
    float wind_speed = doc["wind"]["speed"]; 
    int wind_degree = doc["wind"]["deg"];


    Serial.printf("\nTemperature = %.2f°C\r\n", temp);
    Serial.printf("Humidity = %d %%\r\n", humidity);
    Serial.printf("Pressure = %.3f bar\r\n", pressure);
    Serial.printf("Wind speed = %.1f m/s\r\n", wind_speed);
    Serial.printf("Wind degree = %d°\r\n\r\n", wind_degree);
    http.end(); //Free the resources


    display.clearDisplay();
    display.setTextSize(1);
    display.setTextColor(WHITE);
    display.setCursor(37, 10);
    display.printf("Temperature = %.2f°C\r\n", (float)temp);

    // print degree symbols ( ° )
    display.drawRect(75, 10, 3, 3, WHITE);

    // 2: print humidity
    display.setCursor(43, 33);
    display.printf("Humidity = %d %%\r\n", (float) humidity );

    // 3: print pressure
    display.setCursor(31, 56);
    display.printf("Pressure = %.3f bar\r\n", (float) pressure);

    // update the display
    display.display();


    delay(frequency);
  }
  else if (WiFi.status() != WL_CONNECTED)
  {
    Serial.print(".");
    digitalWrite(2, HIGH);
    delay(500);
    digitalWrite(2, LOW);
    delay(500);
  }
}
void testdrawbitmap(void) {
  display.clearDisplay();

  display.drawBitmap(
    (display.width()  - 64 ) / 2,
    (display.height() - 64) / 2,
    logo_bmp, 64, 64, 1);
  display.display();
  delay(1000);
}
